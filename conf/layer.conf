## conf/layer.conf
```bitbake
# We have a conf and classes directory, add to BBPATH
BBPATH .= ":${LAYERDIR}"

# We have a recipes-* directories, add to BBFILES
BBFILES += "${LAYERDIR}/recipes-*/*/*.bb \
	${LAYERDIR}/recipes-*/*/*.bbappend"

BBFILE_COLLECTIONS += "smart-cities-pilot"
BBFILE_PATTERN_smart-cities-pilot = "^${LAYERDIR}/"
BBFILE_PRIORITY_smart-cities-pilot = "2"

LAYERVERSION_smart-cities-pilot = "1"
LAYERDEPENDS_genividev = "genividev"
```
